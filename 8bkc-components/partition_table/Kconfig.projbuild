## 8bkc-components/partition_table/Kconfig.projbuild
```kconfig
#Stripped for PocketSprite use (real or fake)

config PARTITION_TABLE_FILENAME
       string
       default partitions-pksp-real.csv if HW_POCKETSPRITE
       default partitions-pksp-real-clone.csv if HW_POCKETSPRITE_CLONE

config APP_OFFSET
       hex
       default 0x10000 if HW_POCKETSPRITE_CLONE
       default 0x90000 # this is the factory app offset used by the default tables
```
